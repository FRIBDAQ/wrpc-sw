## configs/cts_defconfig
```kconfig
CONFIG_ARCH_ARM_R5=y
CONFIG_TARGET_CTS=y
CONFIG_LPDC_GTHE4_RXPI=y
CONFIG_IGNORE_HPLL=y
CONFIG_FRAC_SPLL=y
CONFIG_CMD_SFP_INFO=y
CONFIG_SFP_DOM=y
CONFIG_FREQUENCY_MONITOR=y
CONFIG_TRACE_MSGS=y
CONFIG_TRACE_STORAGE_ENABLE=y
CONFIG_TRACE_DEVICES_ENABLE=y
CONFIG_TRACE_PHY_ENABLE=y
CONFIG_LTO=y
```
